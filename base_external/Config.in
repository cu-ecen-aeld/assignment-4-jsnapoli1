## base_external/Config.in
```kconfig
# Pseudocode Block 1: expose external packages to Buildroot menu system.
# - Source each package Config.in under base_external/package.
# - Keep this file minimal so new package directories can be added predictably.
source "$BR2_EXTERNAL_project_base_PATH/package/aesd-assignments/Config.in"
```

## base_external/package/aesd-assignments/Config.in
```kconfig
config BR2_PACKAGE_AESD_ASSIGNMENTS
	bool "aesd-assignments"
	select BR2_PACKAGE_BUSYBOX_SHOW_OTHERS
	help
	  Includes writer, finder.sh, tester.sh, and finder-test.sh in /usr/bin
	  plus finder configuration files in /etc/finder-app/conf.
```
